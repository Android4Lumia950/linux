## Documentation/devicetree/bindings/interconnect/qcom,msm8994.yaml
```yaml
# SPDX-License-Identifier: (GPL-2.0 OR BSD-2-Clause)
%YAML 1.2
---
$id: http://devicetree.org/schemas/interconnect/qcom,msm8994.yaml#
$schema: http://devicetree.org/meta-schemas/core.yaml#

title: Qualcomm MSM8994 Network-On-Chip Interconnect

maintainers:
  - Brian Masney <masneyb@onstation.org>

description: |
  The Qualcomm MSM8994 interconnect providers support setting system
  bandwidth requirements between various network-on-chip fabrics.

properties:
  reg:
    maxItems: 1

  compatible:
    enum:
      - qcom,msm8994-bimc
      - qcom,msm8994-cnoc
      - qcom,msm8994-mmssnoc
      - qcom,msm8994-ovirt
      - qcom,msm8994-pnoc
      - qcom,msm8994-snoc

  clock-names:
    items:
      - const: bus

  clocks:
    items:
      - description: Bus Clock

required:
  - compatible
  - reg

unevaluatedProperties: false

allOf:
  - $ref: qcom,rpm-common.yaml#
  - if:
      properties:
        compatible:
          const: qcom,msm8994-mmssnoc
    then:
      required:
        - clocks
        - clock-names
    else:
      properties:
        clocks: false
        clock-names: false

examples:
  - |
    #include <dt-bindings/clock/qcom,rpmcc.h>

    interconnect@fc380000 {
        reg = <0xfc380000 0x6a000>;
        compatible = "qcom,msm8994-bimc";
        #interconnect-cells = <1>;
    };
```

## Documentation/devicetree/bindings/phy/qcom,dsi-phy-20nm.yaml
```yaml
# SPDX-License-Identifier: GPL-2.0-only OR BSD-2-Clause
%YAML 1.2
---
$id: http://devicetree.org/schemas/phy/qcom,dsi-phy-20nm.yaml#
$schema: http://devicetree.org/meta-schemas/core.yaml#

title: Qualcomm Display DSI 20nm PHY

maintainers:
  - Krishna Manikandan <quic_mkrishn@quicinc.com>

allOf:
  - $ref: qcom,dsi-phy-common.yaml#

properties:
  compatible:
    enum:
      - qcom,dsi-phy-20nm
      - qcom,msm8992-dsi-phy-20nm

  reg:
    minItems: 3
    maxItems: 4
    items:
      - description: dsi pll register set
      - description: dsi phy register set
      - description: dsi phy regulator register set
      - description: DSI1 PLL analog (MSM8992 PLL0 pll_1_base)

  reg-names:
    minItems: 3
    maxItems: 4
    items:
      - const: dsi_pll
      - const: dsi_phy
      - const: dsi_phy_regulator
      - const: dsi_pll_1

  vcca-supply:
    description: Phandle to vcca regulator device node.

  vddio-supply:
    description: Phandle to vdd-io regulator device node.

required:
  - compatible
  - reg
  - reg-names
  - vddio-supply
  - vcca-supply

unevaluatedProperties: false

examples:
  - |
    #include <dt-bindings/clock/qcom,dispcc-sdm845.h>
    #include <dt-bindings/clock/qcom,rpmh.h>

    dsi-phy@fd922a00 {
        compatible = "qcom,dsi-phy-20nm";
        reg = <0xfd922a00 0xd4>,
              <0xfd922b00 0x2b0>,
              <0xfd922d80 0x7b>;
        reg-names = "dsi_pll",
                    "dsi_phy",
                    "dsi_phy_regulator";

        #clock-cells = <1>;
        #phy-cells = <0>;

        vcca-supply = <&vcca_reg>;
        vddio-supply = <&vddio_reg>;

        clocks = <&dispcc DISP_CC_MDSS_AHB_CLK>,
                 <&rpmhcc RPMH_CXO_CLK>;
        clock-names = "iface", "ref";
    };
...
```

## Documentation/devicetree/bindings/power/supply/qcom,pmi8994-fg.yaml
```yaml
# SPDX-License-Identifier: (GPL-2.0-only OR BSD-2-Clause)
%YAML 1.2
---
$id: http://devicetree.org/schemas/power/supply/qcom,pmi8994-fg.yaml#
$schema: http://devicetree.org/meta-schemas/core.yaml#

title: Qualcomm PMI8994 QPNP fuel gauge

maintainers:
  - Konrad Dybcio <konradybcio@kernel.org>

description: |
  QPNP fuel gauge in PMI8994. State of charge, voltage, current, and
  battery temperature live in FG SRAM, accessed through the MEMIF
  peripheral at 0x4400. The gauge identifies the pack by measuring
  the battery ID resistor.

  A 128-byte profile is loaded only when the measured ID is within
  qcom,batt-id-range-pct of qcom,batt-id-kohm. Otherwise the hardware
  SoC is reported and SRAM is left unchanged.

allOf:
  - $ref: power-supply.yaml#

properties:
  compatible:
    const: qcom,pmi8994-fg

  reg:
    maxItems: 1
    description: FG_SOC peripheral base (0x4000 on PMI8994)

  qcom,batt-id-kohm:
    $ref: /schemas/types.yaml#/definitions/uint32
    description: Expected battery ID resistor in kΩ

  qcom,batt-id-range-pct:
    $ref: /schemas/types.yaml#/definitions/uint32
    description: |
      Allowed deviation of the measured ID from qcom,batt-id-kohm,
      as a percentage of that value.

  qcom,fg-profile-data:
    $ref: /schemas/types.yaml#/definitions/uint8-array
    minItems: 128
    maxItems: 128
    description: 128-byte FG SRAM profile from the PMI8994 GUI tool

  qcom,battery-type:
    $ref: /schemas/types.yaml#/definitions/string

  qcom,thermal-coefficients:
    $ref: /schemas/types.yaml#/definitions/uint8-array
    minItems: 6
    maxItems: 6
    description: Six-byte thermistor coefficients written to SRAM 0x444

  qcom,cool-bat-decidegc:
    $ref: /schemas/types.yaml#/definitions/int32
  qcom,warm-bat-decidegc:
    $ref: /schemas/types.yaml#/definitions/int32
  qcom,cold-bat-decidegc:
    $ref: /schemas/types.yaml#/definitions/int32
  qcom,hot-bat-decidegc:
    $ref: /schemas/types.yaml#/definitions/int32

  qcom,fg-cutoff-voltage-mv:
    $ref: /schemas/types.yaml#/definitions/uint32
  qcom,fg-iterm-ma:
    $ref: /schemas/types.yaml#/definitions/uint32
  qcom,fg-chg-iterm-ma:
    $ref: /schemas/types.yaml#/definitions/uint32
  qcom,resume-soc:
    $ref: /schemas/types.yaml#/definitions/uint32

  monitored-battery: true

required:
  - compatible
  - reg

unevaluatedProperties: false

examples:
  - |
    pmic {
      #address-cells = <1>;
      #size-cells = <0>;

      fuel-gauge@4000 {
        compatible = "qcom,pmi8994-fg";
        reg = <0x4000>;
        qcom,batt-id-kohm = <330>;
        qcom,batt-id-range-pct = <15>;
      };
    };
```

## Documentation/devicetree/bindings/usb/lattice,uc120.yaml
```yaml
# SPDX-License-Identifier: (GPL-2.0-only OR BSD-2-Clause)
%YAML 1.2
---
$id: http://devicetree.org/schemas/usb/lattice,uc120.yaml#
$schema: http://devicetree.org/meta-schemas/core.yaml#

title: Lattice UC120 USB Type-C CC / PD PHY (iCE5LP2K)

maintainers:
  - linux-arm-msm@vger.kernel.org

description: |
  The Lattice UC120 is an iCE5LP2K FPGA factory-programmed as the USB-C
  Configuration Channel PHY on Microsoft MSM8992/MSM8994 Octagon (Lumia
  950 / 950 XL). Communication is a proprietary register protocol over SPI.

properties:
  compatible:
    const: lattice,uc120

  reg:
    maxItems: 1

  spi-max-frequency: true

  interrupts:
    maxItems: 1

  usb-psy-name:
    $ref: /schemas/types.yaml#/definitions/string
    description: Name of the USB charger power_supply to receive Type-C
      advertised current via POWER_SUPPLY_PROP_CURRENT_MAX.

  orientation-gpios:
    maxItems: 1
    description: SuperSpeed polarity (HD3SS460 AMSEL/SS_POL). High is
      reverse orientation (ACPI Register 7 polarity bit).

  connector:
    type: object
    $ref: /schemas/connector/usb-connector.yaml#
    unevaluatedProperties: false

    properties:
      compatible:
        const: usb-c-connector

    required:
      - pd-disable

required:
  - compatible
  - reg
  - interrupts
  - connector

additionalProperties: false

examples:
  - |
    #include <dt-bindings/gpio/gpio.h>
    #include <dt-bindings/interrupt-controller/irq.h>

    spi {
        #address-cells = <1>;
        #size-cells = <0>;

        typec@0 {
            compatible = "lattice,uc120";
            reg = <0>;
            spi-max-frequency = <5000000>;
            interrupt-parent = <&tlmm>;
            interrupts = <95 IRQ_TYPE_EDGE_FALLING>;
            usb-psy-name = "qcom-smbchg-usb";
            orientation-gpios = <&pmi_gpios 8 GPIO_ACTIVE_HIGH>;

            connector {
                compatible = "usb-c-connector";
                label = "USB-C";
                power-role = "dual";
                try-power-role = "sink";
                data-role = "dual";
                typec-power-opmode = "default";
                pd-disable;
            };
        };
    };
```
